/*
  Fontname: -wenquanyi-wenquanyi bitmap song-medium-r-normal--16-160-75-75-P-80-iso10646-1
  Copyright: (null)
  Glyphs: 116/41295
  BBX Build Mode: 0
*/
const uint8_t u8g2_font_wqy12_t_dashboard[2295] U8G2_FONT_SECTION("u8g2_font_wqy12_t_dashboard") = 
  "t\0\3\2\4\5\3\5\6\21\22\376\374\13\375\14\374\1\331\3\353\5\207 \5\0\30Q!\10\341\376"
  "P<D\2\42\10d\134QD>\5#\30\310\10\321Ea\24F\321\60D\305(\214\302(\32\206\250"
  "\30\205Q\6$\27\327\370\320\205\203\22ER$\205I\272&a$ERe\20\63\0%\33\330\370\320"
  "hIT\211\222\250\222)\71\20\347@\34iI\224D\225(\22\25\0&\30\311\10U\255Y\230\205Y"
  "\232\344@\30%Q-\251FiV\311\266\0'\10\62\256Q(\12\0(\14\4\313\314E\265(\353\307"
  ",,)\15\4\313L\204\265\60\353\247,\252\1*\17\227(\321\305YTi\333\222\246Z\234\1+\26"
  "\273\12\333\346X\216\345X\216\245\303A\315\261\34\313\261\34K\1,\10B\354P\14\211\2-\7\24\70"
  "K\14\1.\7\42\374P\14\1/\17\6\313\320\26\323bZL\213i\61M\1\60\15\267\12Qm\225"
  "\324\257I\226M\0\61\12\265\16QEc\177\32\4\62\15\267\12Qm\225\64N\373<\14\1\63\23\267"
  "\12\321\14Q\230\3q\232\355@\16\304b\64D\0\64\23\270\12\323\306j\22FY\247\60\32\6\65\7"
  "r \2\65\21\267\12Q\34\344\362\240\3\71\20\307b\64D\0\66\21\267\12Q\15Q\32W&-I"
  "\255I\226M\0\67\15\267\12Q\34\342\64\256\306\325\270\6\70\22\267\12Qm\225TM\262l\253\244j"
  "\222e\23\0\71\20\267\12Qm\225\324\232d\322\22W\243!\2:\7q\14I\244\1;\7\201\374H"
  "\244\2<\20\251\374\330#\261\352\16\350\220\16\345\220\16\11=\12J*Y<\344\344\341\20>\20\252\372"
  "X\344\230\216\351\230\216\351\220\354\35\1\77\16\306\12QiQ\22\212\255uZ\32\1@\26\230\30S\15"
  "Y\230$\223\230(C\242D\211\62$\305l\210\0A\27\271\10U\346H\16$q\222fa\226\15C"
  "\224Fi\222\3:\20B\20\267\10Q\134R\307d\220\302$\265\16C\2C\26\270\10S\15R\232\304"
  "\71\220\3\71\220\3\71\222\3i\64(\0D\20\270\10S\234\322$Mb_\223\64\31&\0E\15\267"
  "\10Q\34\344\346a\211\233\207!F\14\267\10Q\34\344\346a\211;\3G\27\271\10U\15S\234\344@"
  "\216\344H\70\350\200\16$q\22G\303\2H\13\270\10S\304\236\207C\354\71I\11\263\10I,Q\177"
  "\31J\12\344\324Fi\375oC\2K\23\267\10Q\244b\222E\265$T\223\60\312Ja\222\6L\12"
  "\267\10Q\304\375\363\60\4M\34\273\10Y\350\300\220\3K\232(i\42e\221\224EZ\222iI&\206"
  "b\250C\1N\21\270\10S\304\362\252\204R\246Eb\242\316\346\0O\27\272\10W\15[\34\305I\216"
  "\350\210\216\350\210\216\224\243\70\33&\0P\15\267\10Q\134R\257\303\220\304\315\0Q\33\331\350T\15Z"
  "\32\245I\16\350\200\16\350\200\16$Q[\222\15:\222C\11\0R\20\267\10Q\134R\307d\220\302$"
  "LRk\0S\23\267\10Q\15Q(\347@\16\354@\16\304i\62H\0T\25\271\10U<\346H\216"
  "\344H\216\344H\216\344H\216\344H\10U\14\270\10S\304\376\71\11\263!\2V\27\271\10U\344\200\16"
  "$i\224FiV\314\322$Nr GB\0W\36\275\10]\244\251\232\252\225,\311\242,\311\242,"
  "\311*Y\22&Y\22&Y\222\226\323\14X\27\271\10U\344@\222f\325$\7r$\7\222\70I\263"
  "j\222\3\1Y\20\267\10Q\244j\222EY%L\322\270\33\0Z\20\270\10S\34t \316\201\70\7"
  "\342\316\303 [\12\344\374P\14Z\377\333\20\134\24\347\370P\304\71\20\347@\234\3q\16\304\71\20\347"
  "@\34]\12\3\311JL\375\77\15\1^\10\65|UeI-_\7\32\312X<\4`\7\42\216Q"
  "D\1a\21\207\10\321\14Q\30G\203\22&a\222IS\0b\17\267\10Q\304-\223\226\244\256[\222"
  "L\0c\14\206\10OM\231\332\234E\13\0d\15\267\10Q\67-\265\325\65\311\244%e\17\207\10Q"
  "m\225t\70\347@\30\15\11\0f\14\264\10K)Y\64$Y\237\0g\20\267\330P-\265\325\65\311"
  "\244%N\262l\2h\14\267\10Q\304-\223\226\244\276\6i\10\262\10\311\224\224~j\12\343\326F\25"
  "\245\376\264\0k\20\267\10Q\304\215I\26\325\306(+\205I\32l\7\261\12I<\10m\22\213\10Y"
  "$\323\242\31C\61\24C\61\24C\261\0n\12\206\10O$\213&\372\30o\14\207\10Qm\225\324\65"
  "\311\262\11p\26\270\330R(\233\26\245I\232\244I\232hQ\262\345@\16\304\0q\27\270\330R-J"
  "\246\244I\232\244I\32e\332\222\3\71\220\3\11\0r\12\205\10M$\203\26\366\10s\14\206\10\317\14"
  "I(;&C\2t\13\245\10\315\204\331\240\204\275\16u\21\207\10Q\210I\230\204I\230\204I\230d"
  "\322\22v\20\207\10Q\244j\222EY\224U\302$\315\0w\27\213\10Y\204\241\30jI\226DIT"
  "\311\222(\311\222,\15\323\10x\17\207\10Q\244IVI\343\64\311*i\0y\21\267\330P\244j\222"
  "EY%L\322\70\215C\25z\12\206\10O\134\303^\207\1{\14\6\313\320Mi\217Z\254\366<|"
  "\7\1\315H\374\20}\16\6\313P\310i\317\261$\246\335D\0~\10'\232\325L\232\2\0\0\0\4"
  "\377\377QK(\17\351\340\3\71!\7~\7rB\16\15\7\61\207\302\34\12s(\34\16:\220\345X"
  "\35\12s$\15\243\70\334\221AR\60,\16\351\340\303\303!\254#Y\34\325JI\32E\303!\211\302"
  ",\211\302\64\12\323(\31\206\250\230Fa\216\204\203\70\314I\35K\0Ri/\17\351\340\316\311\220C"
  "a\16\15\207\64J\212Q\245)\32\222D\213*M\25\245)RJRm\215*\305(\211\312Z\65\314"
  "\201$\314\221\4R\233\35\14\353\340\346`\16\346`<\274\366\307\70\214\263\34\310r \12\263$N\352"
  "H\4S\5$\376\370`\346p\216\16\327\34\10s$K\206\251\61J\303(\15\243t\230\322J\32\327"
  "\241,\207\302\341\20T\226\70\16\351\340\346p\216\14I\216DI\70H\303\22II\224DR\22%\221"
  "\224DI$%Q\22II\224D\203\22%\221\224DI\24fI\24f\311\220EI\251\30\3T\301"
  " \375\352`\15\307\34\10s \314\201\60\7\302\341\316a\320\206\255\246\325\264\232V\33\266akUa"
  "\64\17\351\340#Q\16F\331\20FY\224\14\321 \205Q\26\205Q\26\205Q\26E\227(\214\262(\214"
  "\262!\214\262(\31\242!G\242\34\214r\60\312\301(\3Y)%\377\350`\15\7\35\312\11\71!'"
  "\344\300\357@\16'\71\232\344`\226cu(\315\201\34Hs(\322A\1Yv+\16\351\340\345p\16"
  "G\303\20\326\222a*F\215Q%\215*C\324\230DY\30%Q\232U\243$J\223LV\263$N"
  "#\0]\347'\377\350`\17\337r$\315\221\60\207\302\34\312r,\33\206\60\207\302\34\12\207\70\331\261"
  "(\7sB\16&\71\234\1]\362 \354\374`<\344`\16\346`\224#Q\216D\303!\312\301\34\314"
  "\301\34\323\61\35K\206\203\0e\345\34\371\356`<\344\200\16\350\200\16\350\300\203\16\350\200\16\350\200\16"
  "\350\300\203\16\4g\11(\17\351`\347\204\34\31\276\346\204\34\36\6\35\210c\71M\206A\214\342\254\234"
  "\3\7\35\210s \316\201\60\311\201\64\4g\37\64\16\351`e\71\224E\203\62\14I\26eQ\26e"
  "Q\26\15\322 eQ\26eQ\26\15R\26e\321 eQ\66\134\262\64\12\243,\11\223\64K\324\12"
  "\0r[#\17\351\340\3\71V\307\352X\35\33\16a\35IsBN\310\201\337\201\234\220\23rBN"
  "\310\11\71\0z\13.\377\350`*\303\220\14Y\32fi\230\245\311\260\14C\230\303;\252$\303\20%"
  "\305\64\211\303(\33\206\60\316\201\70\7\342\34H\206C\0\217\307%\377\370\340\203i\216\304\71\20'\303"
  "!\7sB\66Da\234\225\263r\16\304\71\20\247I\334\222\203\331p\10\217\330'\357\370`e\303 "
  "\306\71\20\347pNH\207P\211\263$J\243Z\230d\305\64G\322\34Is \311\301l\70\4\227b"
  ",\377\350`\374\234\23r\70\7\207\203\30eQ\30eQ\30\15R\30eQ\30eQ\30\15R\30e"
  "Q\30eQ\70\34\304\34\212\0\230\337+\17\351\340\3\71\234\344`\226CI\26k\231\244\14\27-\7"
  "\342\341\234\3\361p\316\221\64\223\342T\7\242\60N\342TG\22\0\0";
